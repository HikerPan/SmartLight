## components/webserver/Kconfig
```kconfig
menu "WEB_SERVER"

    config WEB_SERVER_FILE_PATH
        string "web file save path"
        default "/lfs/web"
        help 
			config web server file path
					

endmenu
```

## components/ymodem/Kconfig
```kconfig
menu "YMODEM"

    config YMODEM_OTA_ENABLE
        bool "enable ymodem ota function"
        default y
        help 
			this is a switch for ymodem ota
	
	config YMODEM_RECEIVE_ENABLE
        bool "enable ymodem rcveive function"
        default y
        help 
			this is a switch for ymodem receive
			
	config YMODEM_SEND_ENABLE
        bool "enable ymodem send function"
        default y
        help 
			this is a switch for ymodem send
	
	config YMODEM_PACKET_SIZE
        int "ymodem packet size"
        default 1024
        help 
				

endmenu
```
